/Set fuses to E2 DF FF

#include < avr / interrupt.h >
#include < avr / io.h >
#include < avr / pgmspace.h > #ifndef cbi

# define cbi(sfr, bit)(_SFR_BYTE(sfr) &= ~_BV(bit))
# endif

# ifndef sbi
# define sbi(sfr, bit)(_SFR_BYTE(sfr) |= _BV(bit))
# endif

//——— Ringbuf parameters ———-

uint8_t Ringbuffer[256];

uint8_t RingWrite = 0;

uint8_t RingRead = 0;

volatile uint8_t RingCount = 0;

volatile uint16_t SFREQ;

//—————————————– //Patterns GU BG2 BD CL CW MA CY QU /* 16 steps ———— Hard rock Disco Reggae Rock Samba Rumba Cha-Cha Swing Bossa Nova Beguine Synthpop 12-steps ——— Boogie Waltz Jazz rock Slow rock Oxygen */
//const unsigned char patlen[16] PROGMEM = {15,15,15,11,15,11,11,11,15,15,15,15,15,15,15,11};
const unsigned char patlen[16] PROGMEM = {15, 15, 15, 15, 15, 15, 15, 15, 15, 15, 15, 11, 11, 11, 11, 11 };
const unsigned char pattern[256] PROGMEM = {

  B00101100, //Hard rock16
  B00000000,
  B00000100,
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  B00000000,

  B00000000

};

const unsigned char BD[270] PROGMEM =

  {

    125,
    111,
    101,
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    128,
    128

  };

const unsigned char BG2[284] PROGMEM =

  {

    125,
    88,
    82,
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    129,
    129

  };

const unsigned char CL[188] PROGMEM =

  {

    92,
    140,
    118,
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    128,
    128

  };

const unsigned char CW[208] PROGMEM =

  {

    150,
    127,
    118,
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    128,
    128

  };

const unsigned char CY[2358] PROGMEM =

  {

    131,
    116,
    126,
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    128,
    128

  };

const unsigned char GU[704] PROGMEM =

  {

    169,
    55,
    207,
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    124,
    132

  };

const unsigned char MA[142] PROGMEM =

  {

    124,
    112,
    125,
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    129,
    127

  };

const unsigned char QU[1928] PROGMEM =

  {

    108,
    185,
    83,
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    128,
    128

  };

ISR(TIMER0_COMPA_vect) {

  //——————- Ringbuffer handler ————————-

  if (RingCount) { //If entry in FIFO..

    OCR1A = Ringbuffer[(RingRead++)]; //Output LSB of 16-bit DAC

    RingCount–;

  }

  //—————————————————————–

}

void setup() {

  OSCCAL = 255;

  // Enable 64 MHz PLL and use as source for Timer1

  PLLCSR = 1 << PCKE | 1 << PLLE;

  // Set up Timer/Counter1 for PWM output

  TIMSK = 0; // Timer interrupts OFF

  TCCR1 = 1 << PWM1A | 2 << COM1A0 | 1 << CS10; // PWM A, clear on match, 1:1 prescale

  //GTCCR = 1<<PWM1B | 2<<COM1B0; // PWM B, clear on match

  OCR1A = 128; //OCR1B = 128; // 50% duty at start

  pinMode(1, OUTPUT); // Enable PWM output pin

  pinMode(2, OUTPUT); // Reset output

  pinMode(0, OUTPUT); // Clock output

  //Set up Timer/Counter0 for 5kHz interrupt to output samples.

  TCCR0A = 3 << WGM00; // Fast PWM

  TCCR0B = 1 << WGM02 | 2 << CS00; // 1/8 prescale

  TIMSK = 1 << OCIE0A; // Enable compare match, disable overflow

  OCR0A = 199; // Divide by 400

  uint16_t dummy = analogRead(0);

}

void loop() {

  uint16_t samplecntBD, samplecntBG2, samplecntCL, samplecntCW, samplecntCY, samplecntGU, samplecntMA, samplecntQU;

  samplecntBD = 0;

  samplecntBG2 = 0;

  samplecntCL = 0;

  samplecntCW = 0;

  samplecntCY = 0;

  samplecntGU = 0;

  samplecntMA = 0;

  samplecntQU = 0;

  uint16_t samplepntBD, samplepntBG2, samplepntCL, samplepntCW, samplepntCY, samplepntGU, samplepntMA, samplepntQU;

  int16_t total;

  uint8_t stepcnt = 0;

  uint16_t tempo = 1;

  uint16_t tempocnt = 1;

  uint16_t LEDclock = 1;

  uint8_t MUX = 2;

  uint8_t patselect = 13;

  uint8_t patlength = pgm_read_byte_near(patlen + patselect);

  sbi(ADCSRA, ADSC); //start next conversation

  while (1) {

    //—— Add current sample word to ringbuffer FIFO ——————–

    if (RingCount < 8) { //if space in ringbuffer

      total = 0;

      if (samplecntBD) {

        total += (pgm_read_byte_near(BD + samplepntBD++) - 128);

        samplecntBD–;

      }

      if (samplecntBG2) {

        total += (pgm_read_byte_near(BG2 + samplepntBG2++) - 128);

        samplecntBG2–;

      }

      if (samplecntCL) {

        total += (pgm_read_byte_near(CL + samplepntCL++) - 128);

        samplecntCL–;

      }

      if (samplecntCW) {

        total += (pgm_read_byte_near(CW + samplepntCW++) - 128);

        samplecntCW–;

      }

      if (samplecntCY) {

        total += (pgm_read_byte_near(CY + samplepntCY++) - 128);

        samplecntCY–;

      }

      if (samplecntGU) {

        total += (pgm_read_byte_near(GU + samplepntGU++) - 128);

        samplecntGU–;

      }

      if (samplecntMA) {

        total += (pgm_read_byte_near(MA + samplepntMA++) - 128);

        samplecntMA–;

      }

      if (samplecntQU) {

        total += (pgm_read_byte_near(QU + samplepntQU++) - 128);

        samplecntQU–;

      }

      if (total < -127) total = -127;

      if (total > 127) total = 127;

      cli();

      Ringbuffer[RingWrite] = total + 128;

      RingWrite++;

      RingCount++;

      sei();

      //—————————————————————————-

      //——— sequencer block ———————————————-

      if (!(tempocnt–)) {

        tempocnt = tempo;

        LEDclock = tempocnt >> 3;

        digitalWrite(0, HIGH); //Clock out Hi

        uint8_t trig = pgm_read_byte_near(pattern + (patselect << 4) + stepcnt);

        if (stepcnt == 0) digitalWrite(2, HIGH); //Reset out Hi

        if (stepcnt != 0) digitalWrite(2, LOW); //Reset out Lo

        if (trig & 1) {

          samplepntQU = 0;

          samplecntQU = 1928;

        }

        if (trig & 2) {

          samplepntCY = 0;

          samplecntCY = 2358;

        }

        if (trig & 4) {

          samplepntMA = 0;

          samplecntMA = 142;

        }

        if (trig & 8) {

          samplepntCW = 0;

          samplecntCW = 208;

        }

        if (trig & 16) {

          samplepntCL = 0;

          samplecntCL = 188;

        }

        if (trig & 32) {

          samplepntBD = 0;

          samplecntBD = 270;

        }

        if (trig & 64) {

          samplepntBG2 = 0;

          samplecntBG2 = 284;

        }

        if (trig & 128) {

          samplepntGU = 0;

          samplecntGU = 704;

        }

        stepcnt++;

        if (stepcnt > patlength) stepcnt = 0; //Reset pattern

      }

      if (!(LEDclock–)) {

        digitalWrite(0, LOW); //Clock out Lo

        LEDclock = tempocnt >> 1;

      }

    }

    //————————————————————————

    //————— ADC block ————————————-

    if (!(ADCSRA & 64)) {

      uint16_t value = ((ADCL + (ADCH << 8)) >> 3) + 1;

      if (MUX == 3) tempo = ((128 - value) << 5) + 312; //17633-1250

      if (MUX == 2) patselect = (value - 1) >> 3;

      if (MUX == 2) patlength = pgm_read_byte_near(patlen + patselect);

      MUX++;

      if (MUX == 4) MUX = 2;

      ADMUX = MUX; //Select MUX

      sbi(ADCSRA, ADSC); //start next conversation

    }

    //—————————————————————

  }

}